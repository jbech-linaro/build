## fit/fit.its
```
/dts-v1/;

/ {
	description = "Linux kernel with QEMU DTB and rootfs";
	#address-cells = <1>;

	images {
		kernel-1 {
			description = "Linux kernel (unverified)";
			data = /incbin/("../../linux/arch/arm64/boot/Image");
			type = "kernel";
			arch = "arm64";
			os = "linux";
			compression = "none";
			load = <0x40400000>;
			entry = <0x40400000>;
		};

		kernel-2 {
			description = "Linux kernel (hash verification)";
			data = /incbin/("../../linux/arch/arm64/boot/Image");
			type = "kernel";
			arch = "arm64";
			os = "linux";
			compression = "none";
			load = <0x40400000>;
			entry = <0x40400000>;
			hash-1 {
				algo = "crc32";
			};
			hash-2 {
				algo = "sha1";
			};
		};

		kernel-3 {
			description = "Linux kernel (RSA verification)";
			data = /incbin/("../../linux/arch/arm64/boot/Image");
			type = "kernel";
			arch = "arm64";
			os = "linux";
			compression = "none";
			load = <0x40400000>;
			entry = <0x40400000>;
			signature-1 {
				algo = "sha1,rsa2048";
				key-name-hint = "private";
			};
		};

		fdt-1 {
			description = "QEMU DTB (dumped from QEMU itself)";
			data = /incbin/("../../out/qemu-aarch64.dtb");
			type = "flat_dt";
			arch = "arm64";
			compression = "none";
			load = <0x40000000>;
			entry = <0x40000000>;
			hash {
				algo = "sha1";
			};
		};

		ramdisk-1 {
			description = "Ramdisk";
			data = /incbin/("../../out/rootfs.cpio.gz");
			type = "ramdisk";
			arch = "arm64";
			os = "linux";
			compression = "none";
			load = <0x44000000>;
			entry = <0x44000000>;
			hash {
				algo = "sha1";
			};
		};
	};

	configurations {
		default = "config-1";

		config-1 {
			description = "Boot Linux kernel (no checks)";
			kernel = "kernel-1";
			fdt = "fdt-1";
			ramdisk = "ramdisk-1";
		};

		config-2 {
			description = "Boot Linux kernel (hash verification)";
			kernel = "kernel-2";
			fdt = "fdt-1";
			ramdisk = "ramdisk-1";
		};

		config-3 {
			description = "Boot Linux kernel (RSA verification)";
			kernel = "kernel-3";
			fdt = "fdt-1";
			ramdisk = "ramdisk-1";
		};

		config-4 {
			description = "Boot Linux kernel (RSA verification of U-Boot config)";
			kernel = "kernel-3";
			fdt = "fdt-1";
			ramdisk = "ramdisk-1";
		};
	};
};
```

## fit/kernel.its
```
/dts-v1/;

/ {
	description = "Linux kernel w. QEMU DTB and rootfs";
	#address-cells = <1>;

	images {
		kernel {
			description = "Vanilla Linux kernel";
			data = /incbin/("../../linux/arch/arm64/boot/Image");
			type = "kernel";
			arch = "arm64";
			os = "linux";
			compression = "none";
			load = <0x40400000>;
			entry = <0x40400000>;
			hash-1 {
				algo = "crc32";
			};
			hash-2 {
				algo = "sha1";
			};
			signature-@1 {
				algo = "sha1,rsa2048";
				key-name-hint = "private";
			};
		};

		fdt {
			description = "QEMU DTB (dumped from QEMU itself)";
			data = /incbin/("../../out/qemu-aarch64.dtb");
			type = "flat_dt";
			arch = "arm64";
			compression = "none";
			load = <0x40000000>;
			entry = <0x40000000>;
			hash {
				algo = "sha1";
			};
		};

		ramdisk {
			description = "Ramdisk";
			data = /incbin/("../../out/rootfs.cpio.gz");
			type = "ramdisk";
			arch = "arm64";
			os = "linux";
			compression = "none";
			load = <0x44000000>;
			entry = <0x44000000>;
			hash {
				algo = "sha1";
			};
		};
	};

	configurations {
		default = "config-1";
		config-1 {
			description = "Boot Linux kernel with a QEMU DTB";
			kernel = "kernel";
			fdt = "fdt";
			ramdisk = "ramdisk";
		};
	};
};
```
